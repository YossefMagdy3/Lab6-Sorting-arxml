AUTOSAR XML
5 x :
  ContainerB  # AA
  ContainerA  # BB
  ContainerC  # CC
  ContainerZ  # DD
  ContainerN  # EE
