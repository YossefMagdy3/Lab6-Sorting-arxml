AUTOSAR XML
5 x :
  ContainerA  # BB
  ContainerB  # AA
  ContainerC  # CC
  ContainerN  # EE
  ContainerZ  # DD
